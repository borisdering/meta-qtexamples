## conf/layer.conf
```bitbake
# We have a conf and classes directory, add to BBPATH
BBPATH .= ":${LAYERDIR}"

# We have recipes-* directories, add to BBFILES
BBFILES += "${LAYERDIR}/recipes-*/*/*.bb \
            ${LAYERDIR}/recipes-*/*/*.bbappend"

BBFILE_COLLECTIONS += "meta-qtexamples"
BBFILE_PATTERN_meta-qtexamples = "^${LAYERDIR}/"
BBFILE_PRIORITY_meta-qtexamples = "6"

LAYERDEPENDS_meta-qtexamples = "core"
LAYERSERIES_COMPAT_meta-qtexamples = "dunfell"
```
